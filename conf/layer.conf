## conf/layer.conf
```bitbake
# We have a conf and classes directory, add to BBPATH
BBPATH .= ":${LAYERDIR}"

# We have recipes-* directories, add to BBFILES
BBFILES += "${LAYERDIR}/recipes-*/*/*.bb \
            ${LAYERDIR}/recipes-*/*/*.bbappend"

BBFILE_COLLECTIONS += "ptx-fpga"
BBFILE_PATTERN_ptx-fpga = "^${LAYERDIR}/"
BBFILE_PRIORITY_ptx-fpga = "11"

LAYERSERIES_COMPAT_ptx-fpga = "gatesgarth hardknott kirkstone"
```

## conf/machine/ecpix5-rocket.conf
```bitbake
#@TYPE: Machine
#@NAME: ecpix5-rocket
#@DESCRIPTION: LambdaConcept ECPIX-5 ECP5 Development Board

DEFAULTTUNE = "riscv64"
FPGA_FAMILY ?= "ecp5"

require conf/machine/include/riscv/tune-riscv.inc

TUNE_CCARGS .= "-march=rv64ima -mabi=lp64"

SERIAL_CONSOLES ?= "115200;ttyLXU0"

PREFERRED_PROVIDER_virtual/kernel = "linux-ecpix5"
KERNEL_IMAGETYPE = "Image"

IMAGE_FSTYPES += "cpio"

# depend on the bitstream/firmware
EXTRA_IMAGEDEPENDS += "litex-boards-rocket linux-on-litex-rocket riscv-pk"

# FIXME The sysvinit init scripts fail to boot to an interactive shell. Use
# Busybox for now until this has been fixed.
VIRTUAL-RUNTIME_dev_manager = "busybox-mdev"
VIRTUAL-RUNTIME_login_manager = "busybox"
VIRTUAL-RUNTIME_init_manager = "busybox"
VIRTUAL-RUNTIME_initscripts = "initscripts"
VIRTUAL-RUNTIME_keymaps = "keymaps"
DISTRO_FEATURES_BACKFILL_CONSIDERED += "sysvinit"
```

## conf/machine/ecpix5-vexriscv.conf
```bitbake
#@TYPE: Machine
#@NAME: ecpix5-vexriscv
#@DESCRIPTION: LambdaConcept ECPIX-5 ECP5 Development Board

DEFAULTTUNE ?= "riscv32"
FPGA_FAMILY ?= "ecp5"

require conf/machine/include/riscv/tune-riscv.inc

TUNE_CCARGS .= "-march=rv32ima -mabi=ilp32 -D__vexriscv__"

SERIAL_CONSOLES ?= "115200;ttyLXU0"

RISCV_SBI_PLAT ?= "litex/vexriscv"

PREFERRED_PROVIDER_virtual/kernel = "linux-ecpix5"
KERNEL_IMAGETYPE = "Image"

IMAGE_FSTYPES += "cpio wic wic.gz"

# The wks depends on ptxsoc-vexriscv, since the boot.json is installed by the
# recipe as a hack.
WKS_FILE_DEPENDS ?= " \
    opensbi \
    e2fsprogs-native \
    ptxsoc-vexriscv \
    virtual/kernel \
"

# FIXME The SD card needs to include the cpio, but adding the cpio image as a
# dependency of the wic image does not work. Therefore, a manual step for
# creating the image is necessary until this is fixed.
#do_image_wic[depends] += "core-image-minimal:do_image_cpio"

IMAGE_BOOT_FILES ?= " \
    Image \
    fw_jump.bin \
    litex-vexriscv-ecpix5.dtb \
    boot.json \
"

WKS_FILE ?= "ecpix5-sdcard.wks"

# The bitstream is not part of the SD card image but must be flashed into the
# SPI flash. The explicit dependency ensures that the bitstream is build.
EXTRA_IMAGEDEPENDS += "ptxsoc-vexriscv"

# TODO The demo scripts are added as a quick hack. Properly add package groups
# or a custom image to cleanup.
#IMAGE_INSTALL:append = " fpga-demo"
IMAGE_INSTALL:append = " fpga-demo stress-ng screen devmem2 htop set-led stress-demo"
#
#INIT_MANAGER ?= "systemd"
```

## meta-ptx-fpga-bsp/conf/layer.conf
```bitbake
# We have a conf and classes directory, add to BBPATH
BBPATH .= ":${LAYERDIR}"

# We have recipes-* directories, add to BBFILES
BBFILES += "${LAYERDIR}/recipes-*/*/*.bb \
            ${LAYERDIR}/recipes-*/*/*.bbappend"

BBFILE_COLLECTIONS += "ptx-fpga-bsp"
BBFILE_PATTERN_ptx-fpga-bsp = "^${LAYERDIR}/"
BBFILE_PRIORITY_ptx-fpga-bsp = "11"

LAYERSERIES_COMPAT_ptx-fpga-bsp = "gatesgarth hardknott kirkstone"
```

## meta-ptx-fpga-bsp/conf/machine/ecpix5-rocket.conf
```bitbake
#@TYPE: Machine
#@NAME: ecpix5-rocket
#@DESCRIPTION: LambdaConcept ECPIX-5 ECP5 Development Board

DEFAULTTUNE = "riscv64"
FPGA_FAMILY ?= "ecp5"

require conf/machine/include/riscv/tune-riscv.inc

TUNE_CCARGS .= "-march=rv64ima -mabi=lp64"

SERIAL_CONSOLES ?= "115200;ttyLXU0"

PREFERRED_PROVIDER_virtual/kernel = "linux-ecpix5"
# riscv-pk uses the vmlinux elf file as payload
KERNEL_IMAGETYPE = "vmlinux"

# The initramfs needs to be bundled in kernel, because this has to be part of
# the riscv-pk payload
INITRAMFS_IMAGE = "core-image-minimal"
INITRAMFS_IMAGE_BUNDLE = "1"

IMAGE_FSTYPES += "cpio"

# depend on the bitstream/firmware
EXTRA_IMAGEDEPENDS += "litex-boards-rocket"

# this is needed to get meta-riscv's glibc append
MACHINEOVERRIDES .= ":qemuriscv64"

# FIXME The sysvinit init scripts fail to boot to an interactive shell. Use
# Busybox for now until this has been fixed.
VIRTUAL-RUNTIME_dev_manager = "busybox-mdev"
VIRTUAL-RUNTIME_login_manager = "busybox"
VIRTUAL-RUNTIME_init_manager = "busybox"
VIRTUAL-RUNTIME_initscripts = "initscripts"
VIRTUAL-RUNTIME_keymaps = "keymaps"
DISTRO_FEATURES_BACKFILL_CONSIDERED += "sysvinit"

# FIXME Latest litex does not build with rocket
SRCREV_pn-litex-native = "080ecad522ad2dec43295517f5111822022554f4"
```

## meta-ptx-fpga-bsp/conf/machine/ecpix5-vexriscv.conf
```bitbake
#@TYPE: Machine
#@NAME: ecpix5-vexriscv
#@DESCRIPTION: LambdaConcept ECPIX-5 ECP5 Development Board

DEFAULTTUNE ?= "riscv32"
FPGA_FAMILY ?= "ecp5"

require conf/machine/include/riscv/tune-riscv.inc

TUNE_CCARGS .= "-march=rv32ima -mabi=ilp32 -D__vexriscv__"

SERIAL_CONSOLES ?= "115200;ttyLXU0"

RISCV_SBI_PLAT ?= "litex/vexriscv"

PREFERRED_PROVIDER_virtual/kernel = "linux-ecpix5"
KERNEL_IMAGETYPE = "Image"
EXTERNAL_KERNEL_DEVICETREE = "litex-vexriscv-ecpix5.dtb"
PREFERRED_PROVIDER_virtual/dtb ?= "devicetree"

IMAGE_FSTYPES += "cpio wic wic.gz"

# The wks depends on ptxsoc-vexriscv, since the boot.json is installed by the
# recipe as a hack.
WKS_FILE_DEPENDS ?= " \
    opensbi \
    e2fsprogs-native \
    devicetree \
    ptxsoc-vexriscv \
    virtual/kernel \
"

IMAGE_BOOT_FILES ?= " \
    Image \
    fw_jump.bin \
    devicetree/litex-vexriscv-ecpix5.dtb \
    boot.json \
"

WKS_FILE ?= "ecpix5-sdcard.wks"

# The bitstream is not part of the SD card image but must be flashed into the
# SPI flash. The explicit dependency ensures that the bitstream is build.
EXTRA_IMAGEDEPENDS += "ptxsoc-vexriscv"

# this is needed to get meta-riscv's glibc append
MACHINEOVERRIDES .= ":qemuriscv32"
```

## meta-ptx-fpga-bsp/conf/machine/ecpix5.conf
```bitbake
#@TYPE: Machine
#@NAME: ecpix5-vexriscv
#@DESCRIPTION: LambdaConcept ECPIX-5 ECP5 Development Board

DEFAULTTUNE ?= "riscv32"
FPGA_FAMILY ?= "ecp5"

require conf/machine/include/riscv/tune-riscv.inc

TUNE_CCARGS .= "-march=rv32ima -mabi=ilp32"

SERIAL_CONSOLES ?= "115200;ttyLXU0"

RISCV_SBI_PLAT ?= "litex/vexriscv"

PREFERRED_PROVIDER_virtual/kernel = "linux-ecpix5-vexriscv"
KERNEL_IMAGETYPE = "Image"

IMAGE_FSTYPES += "cpio"

# depend on the bitstream/firmware
EXTRA_IMAGEDEPENDS += "linux-on-litex-vexriscv opensbi"

# this is needed to get meta-riscv's glibc append
MACHINEOVERRIDES .= ":qemuriscv32"
```

## meta-ptx-fpga-software/conf/layer.conf
```bitbake
# We have a conf and classes directory, add to BBPATH
BBPATH .= ":${LAYERDIR}"

# We have recipes-* directories, add to BBFILES
BBFILES += "${LAYERDIR}/recipes-*/*/*.bb \
            ${LAYERDIR}/recipes-*/*/*.bbappend"

BBFILE_COLLECTIONS += "ptx-fpga-software"
BBFILE_PATTERN_ptx-fpga-software = "^${LAYERDIR}/"
BBFILE_PRIORITY_ptx-fpga-software = "7"

LAYERSERIES_COMPAT_ptx-fpga-software = "gatesgarth"
```

## meta-ptx-fpga-software/recipes-kernel/linux/files/ecpix5-vexriscv/defconfig
```kconfig
CONFIG_IKCONFIG=y
CONFIG_IKCONFIG_PROC=y
CONFIG_BLK_DEV_INITRD=y
CONFIG_ARCH_RV32I=y
# CONFIG_RISCV_ISA_C is not set
# CONFIG_FPU is not set
# CONFIG_EFI is not set
# CONFIG_STRICT_KERNEL_RWX is not set
CONFIG_NET=y
CONFIG_PACKET=y
CONFIG_PACKET_DIAG=y
CONFIG_UNIX=y
CONFIG_UNIX_DIAG=y
CONFIG_INET=y
CONFIG_DEVTMPFS=y
CONFIG_DEVTMPFS_MOUNT=y
CONFIG_MTD=y
CONFIG_MTD_SPI_NOR=y
CONFIG_NETDEVICES=y
CONFIG_LITEX_LITEETH=y
CONFIG_SERIAL_LITEUART=y
CONFIG_SERIAL_LITEUART_CONSOLE=y
CONFIG_I2C_CHARDEV=y
CONFIG_SPI=y
CONFIG_SPI_SPIDEV=y
CONFIG_GPIOLIB=y
CONFIG_DRM=y
CONFIG_FB=y
CONFIG_FB_SIMPLE=y
CONFIG_FRAMEBUFFER_CONSOLE=y
CONFIG_FRAMEBUFFER_CONSOLE_DETECT_PRIMARY=y
CONFIG_LOGO=y
CONFIG_MMC=y
CONFIG_MMC_SPI=y
CONFIG_LITEX_SOC_CONTROLLER=y
CONFIG_PWM=y
CONFIG_SIFIVE_PLIC=y
CONFIG_FPGA=y
CONFIG_EXT2_FS=y
CONFIG_EXT3_FS=y
CONFIG_MSDOS_FS=y
CONFIG_VFAT_FS=y
CONFIG_TMPFS=y
CONFIG_NLS_CODEPAGE_437=y
CONFIG_NLS_ASCII=y
CONFIG_NLS_ISO8859_1=y
CONFIG_PRINTK_TIME=y
```
